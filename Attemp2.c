#include "msp430g2553.h"

const unsigned char font5x8[][5] = { { 0x00, 0x00, 0x00, 0x00, 0x00 },   // sp
        { 0x00, 0x00, 0x2f, 0x00, 0x00 },   // !
        { 0x00, 0x07, 0x00, 0x07, 0x00 },   // "
        { 0x14, 0x7f, 0x14, 0x7f, 0x14 },   // #
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        { 0x02, 0x04, 0x02, 0x01, 0x02 }    // ~
};
unsigned char hour = 12, min, sec, j;

void clearline(unsigned char);
void clearall(void);
void print(char* s);
void gotoXy(unsigned char, unsigned char);
void printc(unsigned char r);
void sendData(unsigned char data);
void sendCmd(unsigned char cmd);

//lcd connected to port 0
#define A0  BIT5 //P2
#define CS  BIT0 //P3
#define SCK BIT4 //P1
#define SDA BIT2 //P1
#define RST BIT4 //P3

void main(void)
{
    WDTCTL = WDT_ADLY_16;         // WDT 1sec, ACLK, interval timer
    IE1 |= WDTIE;                   // Enable WDT interrupt

    BCSCTL1 = CALBC1_1MHZ;
    DCOCTL = CALDCO_1MHZ;

    P2SEL |= BIT1;
    P2SEL2 &= ~BIT1;
    P2DIR |= BIT1;                  // Timer1_A3.TA1
    //P2OUT |= BIT1;
    //TIMER A_1
    TA1CCR0 |= 120;                         // Setting PWM Freq
    TA1CCR1 |= 1;                           // Duty Cycle (G)
    TA1CCTL1 |= OUTMOD_7;                      // Reset/Set Mode
    TA1CTL |= TASSEL_1 + MC_1;               // ACLK and UP TO CCR0

    P1DIR |= BIT2 + BIT4;
    P2DIR |= BIT5;
    P3DIR |= BIT0 + BIT4;
    //P1REN = 0b00010011;
    //P2REN = 0b00111111;

    P1SEL |= SCK + SDA;
    P1SEL2 |= SCK + SDA;

    UCA0CTL0 |= UCCKPH + UCMSB + UCMST + UCSYNC; // 3-pin, 8-bit SPI master
    UCA0CTL1 |= UCSSEL_2; // SMCLK
    UCA0BR0 |= 0x01; // 1:1
    UCA0BR1 = 0;
    UCA0CTL1 &= ~UCSWRST; // clear SW

    P3OUT &= ~RST;
    __delay_cycles(1000);
    P3OUT |= RST;

    P2OUT &= ~A0;
    P3OUT &= ~CS;

//Initialize LCD display
//see http://www.newhavendisplay.com/specs/NHD-C12832A1Z-FSRGB-FBW-3V.pdf  for command set
    sendCmd(0xA1);      //ADC select reverse mode
    sendCmd(0xA2);      //  1/7 bias
    sendCmd(0x2F);      //VC on, VR on, VF on
    sendCmd(0x21);      //resistor ratio 3.5
    sendCmd(0x81);      //set contrast
    sendCmd(0x27);      //adjust this number to get the best contrast
    sendCmd(0xAF);      //now turn it on!

    clearall();
    gotoXy(0, 20);
    print("MSP430G2553 LCD");
    gotoXy(1, 35);
    print("2015-05-22");

    while (1)
    {
        sec++;
        if (sec == 60)
        {
            sec = 0;
            clearline(2);
            min++;
            if (min == 60)
            {
                min = 0;
                hour++;
                if (hour == 24)
                    hour = 0;
            }
        }
        gotoXy(3, 40);
        printc((hour / 10 % 10) + 48);
        printc((hour % 10) + 48);
        printc(':');
        printc((min / 10 % 10) + 48);
        printc((min % 10) + 48);
        printc(':');
        printc((sec / 10 % 10) + 48);
        printc((sec % 10) + 48);

        gotoXy(2, sec);
        print("Hello World!");
        __bis_SR_register(LPM3_bits + GIE);       // Enter LPM3 w/interrupt
    }
}

// Watchdog Timer interrupt service routine
#pragma vector=WDT_VECTOR
__interrupt void watchdog_timer(void)
{
    __bic_SR_register_on_exit(CPUOFF);        // wake up
}

void clearall(void)
{
    unsigned char i;
    for (i = 0; i < 4; i++)
        clearline(i);
}

void clearline(unsigned char line)
{
    unsigned char j;
    sendCmd(0xB0 | line);       //sets page(row)
    sendCmd(0x10);            //sets column address(MSB) to 0 for each page(row)
    sendCmd(0x04);          //sets Column address(LSB) start, for this display 4
    for (j = 0; j < 128; j++)
    {
        sendData(0x00);
    }
}

void sendData(unsigned char data)
{
    P2OUT |= A0;
    UCA0TXBUF = data;
    while (!(IFG2 & UCA0TXIFG))
        ;
}

void sendCmd(unsigned char cmd)
{
    P2OUT &= ~A0;
    UCA0TXBUF = cmd;
    while (!(IFG2 & UCA0TXIFG))
        ;
}

void gotoXy(unsigned char x, unsigned char y)
{
    y += 4;                       //this display does not show first four lines
    sendCmd(0xB0 | (x & 0x03));
    sendCmd(0x10 | ((y >> 4)));
    sendCmd(0x00 | (y & 0x0F));
}

void print(char* s)
{
    while (*s)
        printc(*s++);
}

void printc(unsigned char r)
{
    unsigned char i;
    sendData(0);
    for (i = 0; i < 5; i++)
        sendData(font5x8[r - 32][i]);
}
